// Adafruit_GFX.h — minimal desktop shim of the Adafruit GFX core graphics class,
// enough for the NI404 fork's OLED HUD (display.h): text (built-in 5x7 font),
// cursor, text size/colour, and basic primitives. Subclasses implement
// drawPixel() (see Adafruit_SSD1306.h). Renders into a mono framebuffer.
#ifndef NI404_COMPAT_ADAFRUIT_GFX_H
#define NI404_COMPAT_ADAFRUIT_GFX_H

#include "Arduino.h"   // Print
#include <cstdint>

// Classic 5x7 font, printable ASCII 0x20..0x7E (each glyph = 5 column bytes,
// bit0 = top row). Public-domain "font5x7".
static const uint8_t ni404_font5x7[][5] = {
  {0x00,0x00,0x00,0x00,0x00}, {0x00,0x00,0x5F,0x00,0x00}, {0x00,0x07,0x00,0x07,0x00},
  {0x14,0x7F,0x14,0x7F,0x14}, {0x24,0x2A,0x7F,0x2A,0x12}, {0x23,0x13,0x08,0x64,0x62},
  {0x36,0x49,0x55,0x22,0x50}, {0x00,0x05,0x03,0x00,0x00}, {0x00,0x1C,0x22,0x41,0x00},
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  {0x00,0x41,0x36,0x08,0x00}, {0x08,0x04,0x08,0x10,0x08}
};

#define SSD1306_WHITE 1
#define SSD1306_BLACK 0
#define SSD1306_INVERSE 2
#define BLACK 0
#define WHITE 1

class Adafruit_GFX : public Print {
public:
    Adafruit_GFX(int16_t w, int16_t h) : _width(w), _height(h) {}
    virtual void drawPixel(int16_t x, int16_t y, uint16_t color) = 0;

    int16_t width() const { return _width; }
    int16_t height() const { return _height; }
    void setCursor(int16_t x, int16_t y) { cursor_x = x; cursor_y = y; }
    int16_t getCursorX() const { return cursor_x; }
    int16_t getCursorY() const { return cursor_y; }
    void setTextColor(uint16_t c) { textcolor = textbg = c; }
    void setTextColor(uint16_t c, uint16_t bg) { textcolor = c; textbg = bg; }
    void setTextSize(uint8_t s) { textsize = s ? s : 1; }
    void setTextWrap(bool w) { wrap = w; }
    void cp437(bool = true) {}

    void drawChar(int16_t x, int16_t y, unsigned char c, uint16_t color, uint16_t bg, uint8_t size) {
        if (c < 0x20 || c > 0x7E) c = '?';
        const uint8_t *glyph = ni404_font5x7[c - 0x20];
        for (int8_t i = 0; i < 6; i++) {
            uint8_t line = (i < 5) ? glyph[i] : 0;
            for (int8_t j = 0; j < 8; j++) {
                uint16_t col = (line & 0x1) ? color : bg;
                if ((line & 0x1) || bg != color) {
                    if (size == 1) drawPixel(x + i, y + j, col);
                    else fillRect(x + i * size, y + j * size, size, size, col);
                }
                line >>= 1;
            }
        }
    }

    void fillRect(int16_t x, int16_t y, int16_t w, int16_t h, uint16_t color) {
        for (int16_t j = 0; j < h; j++)
            for (int16_t i = 0; i < w; i++) drawPixel(x + i, y + j, color);
    }
    void drawRect(int16_t x, int16_t y, int16_t w, int16_t h, uint16_t color) {
        for (int16_t i = 0; i < w; i++) { drawPixel(x + i, y, color); drawPixel(x + i, y + h - 1, color); }
        for (int16_t j = 0; j < h; j++) { drawPixel(x, y + j, color); drawPixel(x + w - 1, y + j, color); }
    }
    void drawLine(int16_t x0, int16_t y0, int16_t x1, int16_t y1, uint16_t color) {
        int dx = abs(x1 - x0), dy = -abs(y1 - y0), sx = x0 < x1 ? 1 : -1, sy = y0 < y1 ? 1 : -1, err = dx + dy;
        for (;;) { drawPixel(x0, y0, color); if (x0 == x1 && y0 == y1) break; int e2 = 2 * err;
                   if (e2 >= dy) { err += dy; x0 += sx; } if (e2 <= dx) { err += dx; y0 += sy; } }
    }
    void fillScreen(uint16_t color) { fillRect(0, 0, _width, _height, color); }

    size_t write(uint8_t c) override {
        if (c == '\n') { cursor_x = 0; cursor_y += textsize * 8; }
        else if (c == '\r') { /* skip */ }
        else {
            if (wrap && (cursor_x + textsize * 6) > _width) { cursor_x = 0; cursor_y += textsize * 8; }
            drawChar(cursor_x, cursor_y, c, textcolor, textbg, textsize);
            cursor_x += textsize * 6;
        }
        return 1;
    }
    using Print::write;

protected:
    int16_t _width, _height;
    int16_t cursor_x = 0, cursor_y = 0;
    uint16_t textcolor = 1, textbg = 1;
    uint8_t textsize = 1;
    bool wrap = true;
};

#endif // NI404_COMPAT_ADAFRUIT_GFX_H
