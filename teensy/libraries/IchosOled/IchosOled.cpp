// IchosOled.cpp — implementation of the TŒRN port's OLED HUD (see IchosOled.h).
//
// A self-contained, minimal SSD1306 text driver. We do NOT use Adafruit_GFX or U8g2
// here on purpose: TŒRN leaves only ~700 bytes of RAM1 free, and those libraries push
// several KB of code into RAM1 (Teensy 4 runs code from ITCM by default), which
// overflows the link. Instead every function below is marked FLASHMEM (stays in flash,
// not ITCM) and the font lives in PROGMEM, so this HUD costs essentially zero RAM1.
//
// 128x64 SSD1306 over I2C on the Wire bus it shares with the Audio Shield's SGTL5000
// codec (SDA=18, SCL=19, different I2C addresses). Page-addressing mode, no framebuffer
// (glyphs are streamed straight to the panel), 5x7 font => 21 chars x 8 rows.
#include "IchosOled.h"

#include <Arduino.h>
#include <Wire.h>
#include <string.h>
#include <stdio.h>

#ifndef ICHOS_OLED_ADDR
#define ICHOS_OLED_ADDR 0x3C
#endif
static const int FPS = 12;

// Classic 5x7 glyphs, column-major (LSB = top pixel), ASCII 0x20..0x5F. Mode names and
// numbers are all uppercase, so this 64-glyph range is everything the HUD needs.
static const uint8_t FONT5x7[] PROGMEM = {
  0x00,0x00,0x00,0x00,0x00, 0x00,0x00,0x5F,0x00,0x00, 0x00,0x07,0x00,0x07,0x00, // sp ! "
  0x14,0x7F,0x14,0x7F,0x14, 0x24,0x2A,0x7F,0x2A,0x12, 0x23,0x13,0x08,0x64,0x62, // # $ %
  0x36,0x49,0x55,0x22,0x50, 0x00,0x05,0x03,0x00,0x00, 0x00,0x1C,0x22,0x41,0x00, // & ' (
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  0x40,0x40,0x40,0x40,0x40,                                                     // _
};

static bool oledOk = false;
static unsigned long lastDraw = 0;
static int  lCh = -1, lVol = -1, lBpm = -1, lPage = -1, lPlay = -1, lRec = -1;
static char lMode[16] = "";

FLASHMEM static void cmd(uint8_t c) {
  Wire.beginTransmission(ICHOS_OLED_ADDR);
  Wire.write((uint8_t)0x00);  // Co=0, D/C#=0 -> command stream
  Wire.write(c);
  Wire.endTransmission();
}

// Move the page cursor to (page row 0..7, column 0..127).
FLASHMEM static void setPos(uint8_t page, uint8_t col) {
  cmd(0xB0 | (page & 0x07));
  cmd(0x00 | (col & 0x0F));
  cmd(0x10 | (col >> 4));
}

FLASHMEM static void clearAll() {
  for (uint8_t p = 0; p < 8; p++) {
    setPos(p, 0);
    for (uint8_t c = 0; c < 128; ) {
      Wire.beginTransmission(ICHOS_OLED_ADDR);
      Wire.write((uint8_t)0x40);  // data stream
      for (uint8_t n = 0; n < 16 && c < 128; n++, c++) Wire.write((uint8_t)0x00);
      Wire.endTransmission();
    }
  }
}

// Draw a string at (page, startCol) using the 5x7 font (6px per glyph incl. spacing).
FLASHMEM static void drawStr(uint8_t page, uint8_t startCol, const char *s) {
  setPos(page, startCol);
  uint8_t col = startCol;
  for (; *s && col + 6 <= 128; s++) {
    char ch = *s;
    if (ch < 0x20 || ch > 0x5F) ch = (ch >= 'a' && ch <= 'z') ? ch - 32 : '?';
    if (ch > 0x5F) ch = '?';
    const uint8_t *g = &FONT5x7[(ch - 0x20) * 5];
    Wire.beginTransmission(ICHOS_OLED_ADDR);
    Wire.write((uint8_t)0x40);
    for (uint8_t i = 0; i < 5; i++) Wire.write(pgm_read_byte(g + i));
    Wire.write((uint8_t)0x00);  // 1px gap between glyphs
    Wire.endTransmission();
    col += 6;
  }
}

FLASHMEM void ichosOledBegin() {
  Wire.begin();
  static const uint8_t INIT[] PROGMEM = {
    0xAE, 0xD5, 0x80, 0xA8, 0x3F, 0xD3, 0x00, 0x40, 0x8D, 0x14,
    0x20, 0x02, 0xA1, 0xC8, 0xDA, 0x12, 0x81, 0xCF, 0xD9, 0xF1,
    0xDB, 0x40, 0xA4, 0xA6, 0xAF };
  // Probe: if nothing ACKs at the address, run without a HUD.
  Wire.beginTransmission(ICHOS_OLED_ADDR);
  if (Wire.endTransmission() != 0) { oledOk = false; return; }
  for (uint8_t i = 0; i < sizeof(INIT); i++) cmd(pgm_read_byte(INIT + i));
  oledOk = true;
  clearAll();
  drawStr(0, 0, "TOERN");
  drawStr(2, 0, "KY-040 + OLED PORT");
}

FLASHMEM void ichosOledRender(int ch, int vol, int bpm, int page,
                              const char *mode, bool play, bool rec) {
  if (!oledOk) return;
  const unsigned long now = millis();
  if (now - lastDraw < (unsigned long)(1000 / FPS)) return;

  if (!mode) mode = "";
  const int pl = play ? 1 : 0, rc = rec ? 1 : 0;
  const bool dirty = ch != lCh || vol != lVol || bpm != lBpm || page != lPage ||
                     pl != lPlay || rc != lRec || strncmp(mode, lMode, sizeof(lMode)) != 0;
  if (!dirty) return;

  lastDraw = now;
  lCh = ch; lVol = vol; lBpm = bpm; lPage = page; lPlay = pl; lRec = rc;
  strncpy(lMode, mode, sizeof(lMode) - 1);
  lMode[sizeof(lMode) - 1] = '\0';

  char buf[24];
  clearAll();

  // Current channel — the headline (was the E1/E4 ring colour).
  snprintf(buf, sizeof(buf), "CH:%d", ch);
  drawStr(0, 0, buf);

  // Transport state, right-aligned on the top row.
  const char *t = rec ? "*REC*" : (play ? ">PLAY" : "STOP");
  int col = (21 - (int)strlen(t)) * 6;
  if (col < 0) col = 0;
  drawStr(0, (uint8_t)col, t);

  // Mode, BPM, volume/page.
  snprintf(buf, sizeof(buf), "MODE: %s", mode);
  drawStr(2, 0, buf);
  snprintf(buf, sizeof(buf), "BPM:  %d", bpm);
  drawStr(4, 0, buf);
  snprintf(buf, sizeof(buf), "VOL:%d  PAGE:%d", vol, page);
  drawStr(6, 0, buf);
}
